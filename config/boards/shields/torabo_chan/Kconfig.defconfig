## config/boards/shields/torabo_chan/Kconfig.defconfig
```kconfig
if SHIELD_TORABO_CHAN

config ZMK_KEYBOARD_NAME
    default "Torabo-chan"

endif
```

## config/west.yml
```yaml
manifest:
  remotes:
    - name: zmkfirmware
      url-base: https://github.com/zmkfirmware
    - name: razilyis
      url-base: https://github.com/razilyis
  projects:
    - name: zmk
      remote: zmkfirmware
      revision: v0.3.0
      import: app/west.yml
    - name: zmk-driver-paw3222
      remote: razilyis
      revision: 2260e4756af61c35cac7fd47d29dfc20d9837675
    - name: zmk-driver-zw3021
      remote: razilyis
      revision: 66d9bb919357320c99e6cc1919a051fe14a382e3
  self:
    path: config
```

## diagnostics/Kconfig
```kconfig
config TORABO_DIAGNOSTICS
    bool "Periodic Torabo hardware initialization diagnostics"
    default n
    depends on ZMK_USB_LOGGING
```
